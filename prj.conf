## CMakeLists.txt
```
cmake_minimum_required(VERSION 3.20.0)

find_package(Zephyr REQUIRED HINTS $ENV{ZEPHYR_BASE})
project(blinking_led)

target_sources(app PRIVATE src/main.c)
```

## prj.conf
```kconfig
CONFIG_GPIO=y
CONFIG_SERIAL=y
CONFIG_PRINTK=y
CONFIG_CONSOLE=y
CONFIG_UART_CONSOLE=y
```

## boards/esp32s3_devkitc_esp32s3_procpu.overlay
```dts
/ {
    leds {
        compatible = "gpio-leds";

        myled0: led_0 {
            gpios = <&gpio0 4 GPIO_ACTIVE_HIGH>;
            label = "User LED";
        };
    };

    aliases {
        led0 = &myled0;
    };
};
```

## src/main.c
```c
#include <zephyr/kernel.h>
#include <zephyr/drivers/gpio.h>
#include <zephyr/sys/printk.h>

#define SLEEP_TIME_MS 1000

static const struct gpio_dt_spec led =
    GPIO_DT_SPEC_GET(DT_ALIAS(led0), gpios);

int main(void)
{
    printk("=== boot ===\n");

    if (!gpio_is_ready_dt(&led)) {
        printk("LED device NOT ready\n");
        return 0;
    }

    printk("LED ready: port=%p pin=%d\n", led.port, led.pin);

    gpio_pin_configure_dt(&led, GPIO_OUTPUT);

    while (1) {
        printk("toggle\n");
        gpio_pin_toggle_dt(&led);
        k_msleep(SLEEP_TIME_MS);
    }
}
```
